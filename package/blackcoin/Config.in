## package/blackcoin/Config.in
```kconfig
config BR2_PACKAGE_BLACKCOIN
	bool "blackcoin"
	depends on BR2_PACKAGE_QT || BR2_PACKAGE_QT5
	select BR2_PACKAGE_BERKELEYDB
	select BR2_PACKAGE_DBUS
	select BR2_PACKAGE_MINIUPNP
	select BR2_PACKAGE_OPENSSL
	help
	BlackCoin Currency of the future
	A decentralized stable store of value that uses little energy and that is powered by the people who use it.
	
	http://blackcoin.co/
```

## package/miniupnp/Config.in
```kconfig
config BR2_PACKAGE_MINIUPNP
	bool "miniupnp"
	depends on BR2_LARGEFILE
	depends on BR2_TOOLCHAIN_HAS_THREADS
	help
	  Compiled on a x86 PC, the miniupnp client library has less than 50KB code size.
	  The miniUPnP daemon is much smaller than any other IGD daemon and is ideal for using on low memory device for this reason.
	  It also uses only ONE process and no additional thread, does not use any system() or exec() call, and therefore keeps system resources usage very low. 

	  http://miniupnp.free.fr/

comment "libupnp needs a toolchain w/ largefile, threads"
	depends on !(BR2_LARGEFILE && BR2_TOOLCHAIN_HAS_THREADS)
```

## package/openjdk/Config.in
```kconfig
config BR2_PACKAGE_OPENJDK
	bool "openjdk"
	select BR2_NEEDS_HOST_JAR
	select BR2_NEEDS_HOST_JAVAC
	select BR2_TOOLCHAIN_BUILDROOT_CXX
	select BR2_PACKAGE_XLIB_LIBXRENDER
	select BR2_PACKAGE_XLIB_LIBXTST
	select BR2_PACKAGE_XLIB_LIBX11
	select BR2_PACKAGE_XLIB_LIBXT
	select BR2_PACKAGE_XLIB_LIBXEXT
        select BR2_PACKAGE_ALSA_LIB
        select BR2_PACKAGE_CUPS
	select BR2_PACKAGE_FREETYPE
	help
	  OpenJDK JRE runtime.

	  http://openjdk.java.net/

if BR2_PACKAGE_OPENJDK

choice
	prompt "OpenJDK image"

config BR2_OPENJDK_IMAGE_ALL
        bool "all"
        help
          Install all images produced by the build
          Large footprint!
	
config BR2_OPENJDK_IMAGE_JDK
        bool "jdk"
        help
          A full JDK with javac compiler

config BR2_OPENJDK_IMAGE_JRE
        bool "jre"
        help
          A full runtime JRE

config BR2_OPENJDK_IMAGE_JRE_COMPACT3
        bool "jre compact3"
        help
          A reduced JRE

config BR2_OPENJDK_IMAGE_JRE_COMPACT2
        bool "jre compact2"
        help
          A reduced JRE

config BR2_OPENJDK_IMAGE_JRE_COMPACT1
        bool "jre compact1"
        help
          A reduced JRE

endchoice

choice
        prompt "OpenJDK JVM"

config BR2_OPENJDK_JVM_SERVER
        bool "server"
        help
          A high performance server C2 JIT

config BR2_OPENJDK_JVM_MINIMAL 
        bool "minimal"
        help
          A fast startup client C1 JIT optimized for size
endchoice

config BR2_OPENJDK_CUSTOM_LOCAL
        bool "OpenJDK Local sourcecode directory"
        help
          This option allows Buildroot to get the OpenJDK source
          code from a local directory.
config BR2_OPENJDK_CUSTOM_LOCAL_PATH
        string "Path to the local directory"
        depends on BR2_OPENJDK_CUSTOM_LOCAL
        help
          Path to the local directory with the OpenJDK source code.
config BR2_OPENJDK_CUSTOM_BOOT_JDK
        bool "OpenJDK Specify a custom boot jdk"
        help
	  specifies --with-boot-jdk
          Boot JDK (used to bootstrap build)
config BR2_OPENJDK_CUSTOM_BOOT_JDK_PATH
        string "Path to Boot JDK"
        depends on BR2_OPENJDK_CUSTOM_BOOT_JDK
        help
          Path to the local directory with the OpenJDK source code.
config BR2_OPENJDK_AOT_COMPILER
        bool "OpenJDK JEP 295: Ahead-of-Time Compilation"
        depends on BR2_x86_64
        depends on BR2_BINFMT_ELF
        select BR2_PACKAGE_ELFUTILS
        help
          The JDK 9 version only supports Linux/x64, where the shared library format is ELF.
          Build a compiler that allow compilation of
          Java classes to native code prior to launching the virtual machine.
          http://openjdk.java.net/jeps/295
endif
```
